## app/boards/arm/bakeneko60/Kconfig.board
```kconfig
# Copyright (c) 2023 Andrew Kannan
# SPDX-License-Identifier: MIT

config BOARD_BAKENEKO60
    bool "bakeneko60"
    depends on SOC_NRF52840_QIAA
```

## app/boards/arm/bakeneko65/Kconfig.board
```kconfig
# Copyright (c) 2023 Andrew Kannan
# SPDX-License-Identifier: MIT

config BOARD_BAKENEKO65
    bool "bakeneko65"
    depends on SOC_NRF52840_QIAA
```

## app/dts/bindings/behaviors/zmk,behavior-set-sleep.yaml
```yaml
# Copyright (c) 2025 Andrew Kannan (@awkannan)
# SPDX-License-Identifier: MIT

description: Set sleep behavior

compatible: "zmk,behavior-set-sleep"

include: one_param.yaml
```
